## firmware/esp32-s3/Kconfig.projbuild
```kconfig
menu "CareGuard production options"

config CAREGUARD_CAMERA_STACK_DIAG
    bool "Build isolated camera stack diagnostic"
    default n
    help
        Build only the isolated camera stack diagnostic entry point.
        Leave disabled for the production CareGuard firmware.

config CAREGUARD_TF_WRITE_PROBE
    bool "Build isolated TF write probe"
    default n
    help
        Build only the isolated TF write probe entry point.
        This does not initialize production services.

config CAREGUARD_TF_WRITE_PROBE_WITH_CAMERA
    bool "Run TF write probe after camera init"
    depends on CAREGUARD_TF_WRITE_PROBE
    default n
    help
        Initialize esp32-camera and restore the shared I2C bus before running
        the isolated TF write probe.

endmenu
```

## firmware/esp32-s3/sdkconfig.defaults
```kconfig
CONFIG_ESP32S3_SPIRAM_SUPPORT=y
CONFIG_SPIRAM=y
CONFIG_SPIRAM_BOOT_INIT=y
CONFIG_SPIRAM_IGNORE_NOTFOUND=y
CONFIG_SPIRAM_MODE_QUAD=y
# CONFIG_SPIRAM_MODE_OCT is not set
# CONFIG_SPIRAM_TYPE_AUTO is not set
# CONFIG_SPIRAM_TYPE_ESPPSRAM16 is not set
# CONFIG_SPIRAM_TYPE_ESPPSRAM32 is not set
CONFIG_SPIRAM_TYPE_ESPPSRAM64=y
CONFIG_SPIRAM_SIZE=8388608
CONFIG_SPIRAM_SPEED_80M=y
CONFIG_SPIRAM_USE_MALLOC=y
CONFIG_FREERTOS_HZ=1000
CONFIG_ESPTOOLPY_FLASHSIZE_8MB=y
CONFIG_ESPTOOLPY_FLASHSIZE="8MB"
# CONFIG_ESP_CONSOLE_UART_DEFAULT is not set
CONFIG_ESP_CONSOLE_USB_SERIAL_JTAG=y
# CONFIG_ESP_CONSOLE_UART is not set
```
